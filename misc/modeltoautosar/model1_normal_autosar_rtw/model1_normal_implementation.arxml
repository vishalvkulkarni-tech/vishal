AUTOSAR XML (schema 00052)
package /Components/SwcImplementations
  swc implementation model1_normal_Impl: programming-language=C, sw-version=1.1.1, used-code-generator=Embedded Coder 25.1 (R2025a) 21-Nov-2024, vendor-id=0, behavior=model1_normal_IB
    code-descriptors:
      code Code
        artifact-descriptors:
          short-label=model1_normal_c, category=SWSRC
          short-label=model1_normal_h, category=SWHDR
          short-label=model1_normal_private_h, category=SWHDR
          short-label=model1_normal_types_h, category=SWHDR
    resource consumption RsrcCons_model1_normal
