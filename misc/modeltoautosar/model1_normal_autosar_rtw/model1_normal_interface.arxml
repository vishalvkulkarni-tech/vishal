AUTOSAR XML (schema 00052)
package /Interfaces
  sender receiver interface In1
    data In1: category=VALUE, sw-calibration-access=READ-ONLY, type=float64
  sender receiver interface In2
    data In2: category=VALUE, sw-calibration-access=READ-ONLY, type=float64
  sender receiver interface Out1
    data Out1: category=VALUE, sw-calibration-access=READ-ONLY, type=float64
