AUTOSAR XML (schema 00052)
package /Components
  application sw component type Component1
    require port In1
    require port Out1
