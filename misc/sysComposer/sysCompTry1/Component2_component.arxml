AUTOSAR XML (schema 00052)
package /Components
  application sw component type Component2
    require port In2
    provide port Out2
