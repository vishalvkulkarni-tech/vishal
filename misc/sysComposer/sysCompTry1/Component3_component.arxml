AUTOSAR XML (schema 00052)
package /Components
  application sw component type Component3
    require port In3
    provide port Out3
