AUTOSAR XML (schema 00052)
package /Components
  composition sw component type sysCompTry1
    5 x component:
      Composition: type=Composition
      Component{1..4}: type=Component{1..4}
