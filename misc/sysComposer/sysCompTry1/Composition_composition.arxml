AUTOSAR XML (schema 00052)
package /Components
  composition sw component type Composition
    4 x require port:
      In1
      Client
      In3
      In2
    provide port OutBus
    provide port Server
